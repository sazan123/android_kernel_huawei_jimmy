## drivers/huawei_platform/Kconfig
```kconfig
config HUAWEI_DRIVERS
	bool "huawei drivers"
	default y
	help
	  Say Y here if you want to build the huawei drivers.
	  If unsure, say N here.
source "drivers/huawei_platform/power/Kconfig"
source "drivers/huawei_platform/log/Kconfig"
source "drivers/huawei_platform/uid_iostats/Kconfig"
source "drivers/huawei_platform/net/Kconfig"
source "drivers/huawei_platform/iotrace/Kconfig"
```

## drivers/huawei_platform/power/Kconfig
```kconfig
source "drivers/huawei_platform/power/hw_kstate/Kconfig"
source "drivers/huawei_platform/power/msgnotify/Kconfig"
```

## drivers/input/fingerprint/Kconfig
```kconfig
#
#Fingerprint
#
menu "Fingerprint support"
	depends on INPUT

config MTK_FINGERPRINT_SUPPORT
	bool "Mediatek Fingerprint"
	default n
	---help---
	Fingerprint mtk driver enable/disable in the kernel.
	Say Y here if you want to use mediatek fingerprint driver,
	fingerprint driver will support fingerprint function

if MTK_FINGERPRINT_SUPPORT
config FPC_FINGERPRINT
	bool "FPC Fingerprint"
	default n
	---help---
	FPC fingerprint FPC's 102x/104x device.

config GOODIX_FINGERPRINT
	bool "Goodix Fingerprint"
	default n
	---help---
	Goodix Fingerprint chip GF316M/GF318M/GF3118M/GF518M/GF5118M/GF516M/GF816M/GF3208/GF5216 TEE driver

config GOODIX_SENSOR_TYPE
	string "SENSOR_TYPE"
	default "GF3258"
	---help---
	Must input sensor type, or default is GF316M GF318M GF3118M GF518M GF5118M GF516M GF816M GF3208 GF5216

config FPSENSOR
	bool "FPSensor"
	default n
	---help---
	FPSensor fingerprint.

config CHIPSAILING
	bool "CHIPSAILING"
	default n
	---help---
	CHIPSAILING fingerprint.

endif
endmenu
source "drivers/input/fingerprint/fingerprint/Kconfig"
```

## drivers/input/fingerprint/chipsailing_driver_tee/Kconfig
```kconfig
config CHIPSAILING
	tristate "CHIPSAILING driver"
	default y
	---help---
	  This selects the CHIPSAILING driver.
	  If you want to use CHIPSAILING, say Y or M here.
	  If unsure, say N.
	  This selects the CHIPSAILING driver.
	  If you want to use CHIPSAILING, say Y or M here.
	  If unsure, say N.
```

## drivers/input/touchscreen/mediatek/ft5x26/Kconfig
```kconfig
#
# Copyright (C) 2015 MediaTek Inc.
#
# This program is free software: you can redistribute it and/or modify
# it under the terms of the GNU General Public License version 2 as
# published by the Free Software Foundation.
#
# This program is distributed in the hope that it will be useful,
# but WITHOUT ANY WARRANTY; without even the implied warranty of
# MERCHANTABILITY or FITNESS FOR A PARTICULAR PURPOSE. See the
# GNU General Public License for more details.
#

#
# Touchscreen driver configuration
#
if TOUCHSCREEN_MTK_FT5X26

config TPD_AUTO_UPGRADE
	bool "auto judge and upgreade firmware for ft5x26 touchscreen"
	help
		Auto judge and upgrade firmware function for FT5X26.
		It will auto judge is need to upgrade FW or not in touch driver.
		Say Y here if you want to enable this function.
		If unsure, say N.

config TPD_PROXIMITY
	bool "proximity detection function"
	help
		Touch screen will detect the screen near or far from human face.
		Works just like proximity sensor.
		Say Y here if you want to enable proximity function of touch.
		If unsure, say N.

config FTS_GESTRUE_EN
	bool "gesture wakeup function for ft5x26 touch"
	help
		Gesture wakeup function of FT5X26.
		It can wakeup your set by special gesture on touchscreen.
		Say Y here if you want to enable gesture wakeup function.
		If unsure, say N.

config TPD_CLOSE_POWER_IN_SLEEP
  bool "touch power off when suspend"
	help
		Turn off power for touchscreen in suspend stage.
		It will disable regulator of touch when suspend.
		Say Y here if you want to disable touch regulator when touch suspend.
		If unsure, say N.

endif
```

## drivers/misc/mediatek/accelerometer/bma4xy/Kconfig
```kconfig
#
# Makefile for Bosch sensors driver.
#

config MTK_BMA4XY
	tristate "BMA4XY acceleration sensor support"
	depends on I2C
	default n
	help
	  If you say yes here, you get support for Bosch Sensortec's
	  acceleration sensors BMA4XY.
```

## drivers/misc/mediatek/accelerometer/bmi160_acc/Kconfig
```kconfig
#
# Copyright (C) 2015 MediaTek Inc.
#
# This program is free software: you can redistribute it and/or modify
# it under the terms of the GNU General Public License version 2 as
# published by the Free Software Foundation.
#
# This program is distributed in the hope that it will be useful,
# but WITHOUT ANY WARRANTY; without even the implied warranty of
# MERCHANTABILITY or FITNESS FOR A PARTICULAR PURPOSE. See the
# GNU General Public License for more details.
#

config MTK_BMI160_ACC
	bool "Support Bosch BMI160 accelerometer for MediaTek package"
	help
	  It support different accelerometer sensor.
          If this option is set,
	  it will support
          BMI160 Accelerometer.
```

## drivers/misc/mediatek/accelerometer/mc3451/Kconfig
```kconfig
config MTK_MC3451
	bool "MC3451 for MediaTek package"
	default n
	help
	  It support different accelerometer sensor.
          If this option is set,
	  it will support
          MC3410 Accelerometer.
```

## drivers/misc/mediatek/alsps/stk3x1x-ontim/Kconfig
```kconfig
config MTK_STK3X1X_ONTIM
        bool "stk3x1x_ontim for MediaTek package"
        default n
```

## drivers/misc/mediatek/thermal/Kconfig
```kconfig
config MTK_THERMAL_PA_VIA_ATCMD
	bool "MTK_THERMAL_PA_VIA_ATCMD"
	help
	  Internal switch for thermal management to query modem RF
	  temperature via AT command.


# added by luhongjiang 
config ONTIM_DUAL_85_TEST
	bool "MTK_RT9466_SUPPORT"
	default n
```

## sound/soc/codecs/tas2555_stereo/Kconfig
```kconfig
menu "Texas Instruments TAS2555 SmartAmp(R)"

config SND_SOC_TAS2555_STEREO
	tristate "TI TAS2555 Stereo amp support"
	select TAS2555_I2C_STEREO
	help
        Texas Instruments TAS2555 SmartAmp(R)
        it is a stereo speaker amp solution based on dual TAS2555
        take I2S signal as input and controlled via i2c protocol

        If unsure select "N".

config TAS2555_I2C_STEREO
	tristate "Use of I2C API"
	depends on I2C
	help
        use i2c protocol to read/write register of TAS2555
        select the option to support I2C driver with regmap for
        Texas Instruments TAS2555 High Performance 4W Smart Amplifier

        If unsure select "N".

config TAS2555_CODEC_STEREO
	tristate "TI TAS2555 Codec Driver support"
	help
        register as codec driver for TI TAS2555
        with the option enabled,
        use ASoC codec driver approach and link to machine driver

        If unsure select "N".

config TAS2555_MISC_STEREO
	tristate "TI TAS2555 Misc Driver support"
	help
        register as misc driver for TI TAS2555
        with the option enabled,
        use misc driver approach and user space send ctrl cmd via device node

        If unsure select "N".

endmenu
```
